## CMakeLists.txt
```
cmake_minimum_required(VERSION 3.20)

find_package(Zephyr REQUIRED HINTS $ENV{ZEPHYR_BASE})
project(my_first_app)

# target_sources(app PRIVATE
#     matmulUC0/main.c
#     matmulUC0/header.h
#     matmulUC0/common.h
#     matmulUC0/matrix.c
#     matmulUC0/matrix.h
#     matmulUC0/multiply.c
#     matmulUC0/multiply.h)

# target_sources(app PRIVATE
#     matmulUC1/main.c
#     matmulUC1/header.h
#     matmulUC1/common.h
#     matmulUC1/matrix.c
#     matmulUC1/matrix.h
#     matmulUC1/multiply.c
#     matmulUC1/multiply.h)

# target_sources(app PRIVATE
#     matmulUC2/main.c
#     matmulUC2/header.h
#     matmulUC2/common.h
#     matmulUC2/matrix.c
#     matmulUC2/matrix.h
#     matmulUC2/multiply.c
#     matmulUC2/multiply.h)

# target_sources(app PRIVATE
#     matmulUC3/main.c
#     matmulUC3/header.h
#     matmulUC3/common.h
#     matmulUC3/matrix.c
#     matmulUC3/matrix.h
#     matmulUC3/multiply.c
#     matmulUC3/multiply.h)

# target_sources(app PRIVATE
#     nnUC0/main.c
#     nnUC0/header.h
#     nnUC0/common.h
#     nnUC0/data.h
#     nnUC0/weights.h
#     nnUC0/nn.c
#     nnUC0/nn.h
#     nnUC0/multiply.c
#     nnUC0/multiply.h)

# target_sources(app PRIVATE
#     nnUC1/main.c
#     nnUC1/header.h
#     nnUC1/common.h
#     nnUC1/data.h
#     nnUC1/weights.h
#     nnUC1/nn.c
#     nnUC1/nn.h
#     nnUC1/multiply.c
#     nnUC1/multiply.h)

target_sources(app PRIVATE
    nnUC2/main.c
    nnUC2/header.h
    nnUC2/common.h
    nnUC2/data.h
    nnUC2/weights.h
    nnUC2/nn.c
    nnUC2/nn.h
    nnUC2/multiply.c
    nnUC2/multiply.h)

# target_sources(app PRIVATE
#     nnUC3/main.c
#     nnUC3/header.h
#     nnUC3/common.h
#     nnUC3/data.h
#     nnUC3/weights.h
#     nnUC3/nn.c
#     nnUC3/nn.h
#     nnUC3/multiply.c
#     nnUC3/multiply.h)
```

## prj.conf
```kconfig
CONFIG_SWERV_PIC=y

CONFIG_NEWLIB_LIBC_FLOAT_PRINTF=y
CONFIG_NEWLIB_LIBC=y

CONFIG_TEST_RANDOM_GENERATOR=y
```

## src/main.c
```c
#include "header.h"

#define mat1Addr 0x02000000
#define mat2Addr 0x02000100
#define resultSwAddr 0x02000200
#define resultHwAddr 0x02000300

#define MY_DEV_IRQ  15       /* device uses IRQ 13 */
#define MY_DEV_PRIO  10       /* device uses interrupt priority 10 */


int mat1Rows=8, mat1Cols=8, mat2Rows=8, mat2Cols=8;
int accelFlag=0;

void my_isr_installer(void) {
    ARCH_IRQ_CONNECT(MY_DEV_IRQ, MY_DEV_PRIO, my_isr, NULL, 0);
    arch_irq_enable(MY_DEV_IRQ);
}

void my_isr(const void *arg) {
    *acceleratorGIER = 0;
    *acceleratorIP_IER = 0;
    printf("Inside my isr!\n");
    accelFlag=1;
    return;
}

int main()
{
    *acceleratorGIER = 1;
    *acceleratorIP_IER = 1;

    printf("Starting swerv irq!\n");
    my_isr_installer();

    create_mat(mat1Addr, mat1Rows, mat1Cols);
    create_mat(mat2Addr, mat2Rows, mat2Cols);

    printf("Starting matmul in hardware!\n");
    multiply_mat_hw(mat1Addr, mat2Addr, resultHwAddr, mat1Rows, mat1Cols, mat2Cols);
    // print_mat(resultHwAddr, mat1Rows, mat2Cols);
    while(accelFlag == 0) {}
    printf("Hardware matmul done!\n");
    multiply_mat_sw(mat1Addr, mat2Addr, resultSwAddr, mat1Rows, mat1Cols, mat2Cols);
    print_mat(resultSwAddr, mat1Rows, mat2Cols);

    int errors = verify_matmul(resultHwAddr, resultSwAddr, mat1Rows, mat2Cols);
    printf("Matmul done with %d errors!\n", errors);


    return 0;
}

// void reset_csr(int CSR_ADDR, int MASK) {
//     volatile uint32_t *csr = (uint32_t *)CSR_ADDR;
//     csr &= ~MASK;
// }

// void set_csr(int CSR_ADDR, int MASK) {
//     volatile uint32_t *csr = (uint32_t *)CSR_ADDR;
//     csr |= MASK;
// }

// void setup_interrupts() {
//     reset_csr(MIE_ADDR, MIE_EIE_MASK); // disable external interrupts

//     printf("1\n");

//     reset_CSR(PIC_MPICCFG_ADDR, MPICCFG_PRIORD_MASK); // configure priority order 0=lowest to 15=highest 

//     printf("2\n");

//     reset_csr(MEIPT_ADDR, MEIPT_PRITHRESH_MASK); // set priority threshold to 0

//     printf("4\n");

//     volatile int *meigwctrlS = (int *)(PIC_BASE_ADDRESS + 0x4004); // Address of meigwctrlS register
//     volatile int *meigwclrS = (int *)(PIC_BASE_ADDRESS + 0x5004); // Address of meigwclrS register
//     volatile int *meipIS = (int *)(PIC_BASE_ADDRESS + 0x0004); // Address of meipIS register
//     volatile int *meieS = (int *)(PIC_BASE_ADDRESS + 0x2004); // Address of meieS register
//     volatile int *addressTable = (int *)EXTERNAL_INTERRUPT_ADDRESS_TABLE;
//     for(int i=0; i<8; i++) {
//         set_csr(PIC_MEIGWCTRL_ADDR+4*i, 0x0002); // set type to edge triggered
//         reset_csr(PIC_MEIGWCTRL_ADDR+4*i, 0x0001); // set polarity to active-high
//         meigwclrS[i] = 0; // clear the IP bit in the meigwclrS register
//         meipIS[i] = 2; // set priority threshold to 2 for each external interrupt (bits 3 to 0)
//         meieS[i] |= 0x0001; // set inten (bit 0) to enable interrupts
//         addressTable[i] = &my_isr;
//     }

//     printf("5\n");

//     volatile int *mstatus = (int *)(CSR_BASE_ADDRESS + 0x300); // Address of mstatus register
//     *mstatus |= 1 << 3; // set bit mie (bit 3) of the mstatus CSR

//     printf("6\n");

//     *mie |= (1 << 11); // set bit miep (bit 11) of the mie CSR
// }
```

## src/defines.h
```c
#ifndef DEFINES_H
#define DEFINES_H

#define ACCELERATOR_BASE_ADDRESS            0x90000000
#define MEM_BASE_ADDRESS                    0x02000000

#define NUM_MATMULS 100

#endif //DEFINES_H
```

## src/header.h
```c
#ifndef HEADER_H
#define HEADER_H

#include <stdio.h>
#include <zephyr.h>
#include <kernel.h>
#include <sys/printk.h>
#include <random/rand32.h>

#include "defines.h"
#include "matrix.h"
#include "multiply.h"

volatile int *acceleratorGIER = (int *)(ACCELERATOR_BASE_ADDRESS + 0x04);
volatile int *acceleratorIP_IER = (int *)(ACCELERATOR_BASE_ADDRESS + 0x08);


void my_isr_installer(void);
void my_isr(const void *arg);


#endif //HEADER_H
```

## src/matrix.c
```c
#include "matrix.h"

void create_mat(int address, int rows, int cols)
{
    float *matrix = (float *)address;

    for (int i=0; i<rows; i++) {
        for (int j=0; j<cols; j++) {
            int random_integer = sys_rand32_get()%1000;
            matrix[i*cols+j] = (float)random_integer / 10;
        }
    }
}

void print_mat(float *matrix, int rows, int cols)
{
    for (int i=0; i<rows; i++) {
        for (int j=0; j<cols; j++) {
            printf("%.4f\n", matrix[i*cols+j]);
        }
        printk("\n");
    }
    printk("\n\n");
}

int verify_matmul(float *mat1, float *mat2, int rows, int cols)
{
    int num_errors = 0;

    for (int i=0; i<rows; i++) {
        for (int j=0; j<cols; j++) {
            if(mat1[i*cols+j]-mat2[i*cols+j] >= 0.01) num_errors++;
        }
    }

    return num_errors;
}
```

## src/matrix.h
```c
#ifndef MATRIX_H
#define MATRIX_H

#include <stdio.h>
#include <zephyr.h>
#include <kernel.h>
#include <sys/printk.h>
#include <random/rand32.h>

#include "defines.h"

void create_mat(int address, int rows, int cols);
void print_mat(float *x, int colsize, int rowsize);
int verify_matmul(float *mat1, float *mat2, int rows, int cols);

#endif //MATRIX_H
```

## src/multiply.c
```c
#include "multiply.h"

void multiply_mat_sw(float *mat1, float *mat2, int result_address, int rows1, int cols1, int cols2)
{
    float *result = (float *)result_address;

    for (int i=0; i<rows1; i++) {
        for (int j=0; j<cols2; j++) {
            float val = 0;
            for (int k=0; k<cols1; k++) {
                val += mat1[i*cols1+k]*mat2[k*cols2+j];
            }
            result[i*cols2+j] = val;
        }
    }
}

void multiply_mat_hw(int mat1_address, int mat2_address, int result_address, int rows1, int cols1, int cols2)
{
    volatile int *do_matp_mem = (int *)(ACCELERATOR_BASE_ADDRESS + 0x00);
    volatile int *a = (int *)(ACCELERATOR_BASE_ADDRESS + 0x10);
	volatile int *b = (int *)(ACCELERATOR_BASE_ADDRESS + 0x18);
	volatile int *c = (int *)(ACCELERATOR_BASE_ADDRESS + 0x20);
	volatile int *rowsA = (int *)(ACCELERATOR_BASE_ADDRESS + 0x28);
	volatile int *colsA = (int *)(ACCELERATOR_BASE_ADDRESS + 0x30);
	volatile int *colsB = (int *)(ACCELERATOR_BASE_ADDRESS + 0x38);

    *a = mat1_address;
    *b = mat2_address;
    *c = result_address;
    *rowsA = rows1;
    *colsA = cols1;
    *colsB = cols2;

    *do_matp_mem = 1;

    while ((*do_matp_mem & 2) == 0);
}
```

## src/multiply.h
```c
#ifndef MULTIPLY_H
#define MULTIPLY_H

#include <stdio.h>
#include <zephyr.h>
#include <kernel.h>
#include <sys/printk.h>
#include <random/rand32.h>

#include "defines.h"

void multiply_mat_sw(int mat1Address, int mat2Address, int resultAddress, int rows1, int cols1, int cols2);
void multiply_mat_hw(int mat1Address, int mat2Address, int resultAddress, int rows1, int cols1, int cols2);

#endif //MULTIPLY_H
```
